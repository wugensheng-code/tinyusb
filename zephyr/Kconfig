## zephyr/Kconfig
```kconfig
# Copyright (c) 2022 Nordic Semiconductor ASA
# SPDX-License-Identifier: Apache-2.0

menuconfig TINYUSB
	bool "tinyusb"
	help
	  Use the tinyusb.

if TINYUSB

config TINYUSB_THREAD_STACK_SIZE
	int "Stack size for tinyusb thread"
	default 2048
	help
	  Stack size for tinyusb thread

config TINYUSB_THREAD_PRIO
	int "tinyusb thread priority"
	default 0
	help
	  Cooperative priority of tinyusb thread.


module = TINYUSB
module-str = tinyusb
default-count = 1
source "subsys/logging/Kconfig.template.log_config"

rsource "Kconfig.renesas"

endif # TINYUSB
```

## zephyr/Kconfig.renesas
```kconfig
# Copyright (c) 2022 Nordic Semiconductor ASA
# SPDX-License-Identifier: Apache-2.0

menuconfig TINYUSB_RENESAS
	bool "tinyusb renesas driver"
	depends on DT_HAS_RENESAS_RA_UDC_ENABLED
    default y
	select USE_RA_FSP_USB_DEVICE
	help
	  Use the tinyusb.

if TINYUSB_RENESAS

config TINYUSB_RENESAS_THREAD_STACK_SIZE
	int "Stack size for tinyusb thread"
	default 2048
	help
	  Stack size for tinyusb thread

config TINYUSB_RENESAS_THREAD_PRIO
	int "tinyusb renesas thread priority"
	default SYSTEM_WORKQUEUE_PRIORITY
	help
	  Cooperative priority of tinyusb renesas thread.


module = USB_RENESAS
module-str = usb_renesas
default-count = 1
source "subsys/logging/Kconfig.template.log_config"

endif
```
